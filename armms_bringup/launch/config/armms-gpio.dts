/dts-v1/;
/plugin/;

/ {
    overlay-name = "ARMMS GPIO pin definition";
    compatible = "brcm,bcm2708";

    fragment@0 {
        target = <&gpio>;
        __overlay__ {
            pinctrl-names = "default";
            pinctrl-0 = <&my_pins>;
            my_pins: my_pins {
                brcm,pins = <17 27 22>;    /* GPIO7 */
                brcm,function = <1 1 1 >;  /* Output */
		        brcm,pull = <0 0 0>;       /* No internal pull up/down */		
            };
        };
    };
};
